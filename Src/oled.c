/*
 * oled.c
 *
 *  Created on: 2 cze 2017
 *      Author: Virtmedia
 */
#include "main.h"
#include "stm32f1xx_hal.h"
#include "i2c.h"
#include "oled.h"
#define OLED_ADDRESS (0x78)


#define COLADDLOW 0
#define COLADDHIGH 0x10
#define PAGEADD 0xB0
#define LINEADD 0x40
#define OLEDON 0xAE

#define SSD1306_SETCONTRAST 0x81
#define SSD1306_DISPLAYALLON_RESUME 0xA4
#define SSD1306_DISPLAYALLON 0xA5
#define SSD1306_NORMALDISPLAY 0xA6
#define SSD1306_INVERTDISPLAY 0xA7
#define SSD1306_DISPLAYOFF 0xAE
#define SSD1306_DISPLAYON 0xAF

#define SSD1306_SETDISPLAYOFFSET 0xD3
#define SSD1306_SETCOMPINS 0xDA

#define SSD1306_SETVCOMDETECT 0xDB

#define SSD1306_SETDISPLAYCLOCKDIV 0xD5
#define SSD1306_SETPRECHARGE 0xD9

#define SSD1306_SETMULTIPLEX 0xA8

#define SSD1306_SETLOWCOLUMN 0x00
#define SSD1306_SETHIGHCOLUMN 0x10

#define SSD1306_SETSTARTLINE 0x40

#define SSD1306_MEMORYMODE 0x20
#define SSD1306_COLUMNADDR 0x21
#define SSD1306_PAGEADDR   0x22

#define SSD1306_COMSCANINC 0xC0
#define SSD1306_COMSCANDEC 0xC8

#define SSD1306_SEGREMAP 0xA0

#define SSD1306_CHARGEPUMP 0x8D

#define SSD1306_EXTERNALVCC 0x1
#define SSD1306_SWITCHCAPVCC 0x2

// Scrolling #defines
#define SSD1306_ACTIVATE_SCROLL 0x2F
#define SSD1306_DEACTIVATE_SCROLL 0x2E
#define SSD1306_SET_VERTICAL_SCROLL_AREA 0xA3
#define SSD1306_RIGHT_HORIZONTAL_SCROLL 0x26
#define SSD1306_LEFT_HORIZONTAL_SCROLL 0x27
#define SSD1306_VERTICAL_AND_RIGHT_HORIZONTAL_SCROLL 0x29
#define SSD1306_VERTICAL_AND_LEFT_HORIZONTAL_SCROLL 0x2A

  #define SSD1306_LCDWIDTH                  128
  #define SSD1306_LCDHEIGHT                 64

uint8_t OLED_Buffer_Init[];
const char dig_mid[];
const char dig_big[];
const char rom_gen[];
const unsigned char bmp[1026];

uint8_t OLED_Buffer_Init[]={
	0x80,	//control byte
	0xae,//Display OFF
	0x00,//Low Column
	0x10,//High Column
	0xB0,//Page
	0x40,//Start line
	0xA1,//remap
	0xDA,//com pins
	0x12,
	0xD3, //display offset
	0x00,//NO offset
	0xc0,//scan direction
	0xc8,
	0xA6,//normal display
	0xA4,//display ON
	0x81,//set contrast
	0x50,//contrast DATA
	0xa8,//multiplex ratio
	0x3f,//1/64 duty
	0xD5,//Display clock divide
	0x80,
	0xd9,//precharge period
	0xF1,
	0xDB,//VCOM deselect
	0x40,
	0x8d,//charge pump
	0x14,
	0xAF,//display ON
};
uint8_t Buffer_Data[1024];

void OLED_Init(void)
{
	//HAL_I2C_Mem_Write(&hi2c1, OLED_ADDRESS, 0x80, 1, OLED_Buffer_Init, sizeof(OLED_Buffer_Init), 100000);
	//HAL_I2C_Master_Transmit(&hi2c1,OLED_ADDRESS, (uint8_t *)OLED_Buffer_Init, 28,100000 );
/*
	OLED_Cmd(SSD1306_DISPLAYOFF);
	OLED_Cmd(SSD1306_SETDISPLAYCLOCKDIV);
	OLED_Cmd(0x80);
	OLED_Cmd(SSD1306_SETMULTIPLEX);
	OLED_Cmd(SSD1306_LCDHEIGHT - 1);
	OLED_Cmd(SSD1306_SETDISPLAYOFFSET);
	OLED_Cmd(0x0);
	OLED_Cmd(SSD1306_SETSTARTLINE | 0x0);
	OLED_Cmd(SSD1306_CHARGEPUMP);
	OLED_Cmd(0x10); //vccstate == SSD1306_EXTERNALVCC
	OLED_Cmd(SSD1306_MEMORYMODE);
	OLED_Cmd(0x00);
	OLED_Cmd(SSD1306_SEGREMAP | 0x1);
	OLED_Cmd(SSD1306_COMSCANDEC);
	OLED_Cmd(SSD1306_SETCOMPINS);
	OLED_Cmd(0x12);
	OLED_Cmd(SSD1306_SETCONTRAST);
	OLED_Cmd(0x9F);
	OLED_Cmd(SSD1306_SETPRECHARGE);
	OLED_Cmd(0x22);
	OLED_Cmd(SSD1306_SETVCOMDETECT);
	OLED_Cmd(0x40);
	OLED_Cmd(SSD1306_DISPLAYALLON_RESUME);
	OLED_Cmd(SSD1306_NORMALDISPLAY);
	OLED_Cmd(SSD1306_DEACTIVATE_SCROLL);
	OLED_Cmd(SSD1306_DISPLAYON);
	*/
}

HAL_StatusTypeDef OLED_Cmd(uint8_t data)
{
	uint8_t BufData[2];
	BufData[0]=0x80;
	BufData[1]=data;
	return ( HAL_I2C_Master_Transmit(&hi2c1,OLED_ADDRESS, BufData, 2,0xffffffff ) );
			//(I2C_Master_BufferWrite(I2C1, BufData,2,DMA, 0x78));
}

HAL_StatusTypeDef OLED_Data(uint8_t data)
{
	uint8_t BufData[3];
	BufData[0]=0x40;
	BufData[1]=data;
	return(HAL_I2C_Master_Transmit(&hi2c1,OLED_ADDRESS, BufData, 2,100000 ));
}

void SetPosChar(uint8_t x, uint8_t y)
{
	SetColumn(x*6);
	SetPage(y);
}

void SetPos(uint8_t x, uint8_t y)
{
	SetColumn(x);
	SetPage(y);
}

void CharMedium(uint8_t cyfra, uint8_t x,uint8_t y )
{
	int i;
	SetPos(x*10,y*2);
	for(i=cyfra*20;i<cyfra*20+10;i++)
		OLED_Data(dig_mid[i]);

	SetPos(x*10,(y*2)+1);
	for(i=cyfra*20+10;i<cyfra*20+20;i++)
		OLED_Data(dig_mid[i]);

}

void CharBig(uint8_t cyfra, uint8_t x,uint8_t y )
{
	int i;
	SetPos(x*15,y*3);
	for(i=cyfra*45;i<cyfra*45+15;i++)
		OLED_Data(dig_big[i]);

	SetPos(x*15,(y*3)+1);
	for(i=cyfra*45+15;i<cyfra*45+30;i++)
		OLED_Data(dig_big[i]);

	SetPos(x*15,(y*3)+2);
	for(i=cyfra*45+30;i<cyfra*45+45;i++)
		OLED_Data(dig_big[i]);

}

void WriteChar(char code)
{
int code_point;

	code_point=((int)code*6);

	OLED_Data(rom_gen[code_point++]);
	OLED_Data(rom_gen[code_point++]);
	OLED_Data(rom_gen[code_point++]);
	OLED_Data(rom_gen[code_point++]);
	OLED_Data(rom_gen[code_point++]);
	OLED_Data(rom_gen[code_point]);

}

void OledTxt(const char *napis,char x,char y)
{
	SetPosChar(x,y);//pozycja tekstu na wyswietlaczu
    while(*napis!=0)
	{WriteChar(*napis);
    ++napis;}
}

uint8_t SetColumn(uint8_t column)
{
	if(column>128)
		return(1);
	++column;
	++column;
	OLED_Cmd(COLADDLOW|(column&0x0f));
	OLED_Cmd(COLADDHIGH|(column>>4));
	return(0);
}

uint8_t SetLine(uint8_t line)
{
	if(line>32)
	return(1);
	OLED_Cmd(LINEADD|line);
	return(0);
}

uint8_t SetPage(uint8_t page)
{
	if(page>7)
	return(1);
	OLED_Cmd(PAGEADD|page);
	return(0);
}

void OledBmp(void)
{
	uint16_t i,j,k;
	SetColumn(0);
	SetLine(0);
	SetPage(0);
	k=0;
	for(j=0;j<8;j++)
	{
		SetPage(j);
		SetColumn(0);
		for (i=0; i<128; i++)
		{
			OLED_Data(bmp[k++]);
		}
	}
}

void OledCls(void)
{
	uint16_t i,j;
	SetColumn(0);
	SetLine(0);

	for(j=0;j<8;j++)
	{
		SetPage(j);
		SetColumn(0);
		for (i=0; i<128; i++)
		{
			OLED_Data(0x00);
		}
	}
}


const char dig_mid[]={//szerokosc 10 pikseli
	0xF8, 0xFE, 0x07, 0x03, 0x03, 0x03, 0x07, 0xFE, 0xF8,0,	//0
	0x07, 0x1F, 0x38, 0x30, 0x30, 0x30, 0x38, 0x1F, 0x07,0,
	0,0,0x18, 0x18, 0x0C, 0xFF, 0xFF,0,0,0,//1
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	0x00, 0x00, 0x00, 0x00, 0x3F, 0x3F, 0x00, 0x00, 0x00, 0x00,
};
const char dig_big[]={//szerokosc 15pikseli
	0xE0, 0xF8, 0xFE, 0x3E, 0x0F, 0x07, 0x07, 0x07, 0x07, 0x0F, 0x3E, 0xFE, 0xF8, 0xC0,0,//0
	0x7F, 0xFF, 0xFF, 0x80, 0x00, 0x00, 0x00, 0x00, 0x00, 0x00, 0x80, 0xFF, 0xFF, 0xFF,0,
	0x00, 0x03, 0x0F, 0x0F, 0x1E, 0x1C, 0x1C, 0x1C, 0x1C, 0x1E, 0x0F, 0x0F, 0x03, 0x00,0,
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	0x01, 0x07, 0x0F, 0x0E, 0x1C, 0x18, 0x18, 0x18, 0x18, 0x1C, 0x0E, 0x0F, 0x07, 0x01, 0x00,


};
const char rom_gen[]={0x48,0x54,0x56,0x54,0x20,0,//kod œ
0x20,0x54,0x54,0xd4,0x78,0,//kod ¹
0x38,0x44,0x46,0x44,0x20,0,//kod æ
0,0,0,0,0,0,//kod 3
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0x78,0x46,0x41,0x46,0x78,0x00,
};

// bitmapa monochromatyczna kamami.bmp
// 1 dimension array of V-8 patterns with size header : hsize, vsize/8
// bitmapa monochromatyczna kamami.bmp
// 1 dimension array of V-8 patterns with size header : hsize, vsize/8
const unsigned char bmp1[1026]=
{

0x00,0x00,0x00,0x00,0x00,0x00,0x00,0x00,0x00,0x00,0x00,0x00,0x00,0x00,0x00,0x00,
0x00,0x00,0x00,0x00,0x00,0x00,0x00,0x00,0x00,0x00,0x00,0x00,0x00,0x00,0x00,0x00,
0x00,0x00,0x00,0x00,0x00,0x00,0x00,0x00,0x00,0x00,0x00,0x00,0x00,0x00,0x00,0x00,
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0x00,0x00,0x00,0x00,0x00,0x00,0x00,0x00,0x00,0x00,0x00,0x00,0x00,0x00,0x00,0x00
};





// bitmapa monochromatyczna ep.bmp
// 1 dimension array of V-8 patterns with size header : hsize, vsize/8
const unsigned char bmp[1026]=
{

0x00,0x00,0x00,0x00,0x00,0x00,0x00,0x00,0x00,0x00,0x00,0x00,0x00,0x00,0x00,0x00,
0x00,0x00,0x00,0x00,0x00,0x00,0x00,0x00,0x00,0x00,0x00,0x00,0x00,0x00,0x00,0x00,
0x00,0x00,0x00,0x00,0x00,0x00,0x00,0x00,0x00,0x00,0x00,0x00,0x00,0x00,0x00,0x00,
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0x00,0x00,0x00,0x00,0x00,0x00,0x00,0x00,0x00,0x00,0x00,0x00,0x00,0x00,0x00,0x00
};

